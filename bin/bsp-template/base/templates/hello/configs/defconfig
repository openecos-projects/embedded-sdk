## bin/bsp-template/base/templates/hello/configs/defconfig
```kconfig
# @BSP_NAME@ hello 示例默认配置。
# [不要修改] hello 示例使用系统串口，因此默认打开对应驱动。
CONFIG_DRIVER_SYS_UART=y

# [按需修改] hello 示例不使用 GPIO，默认关闭以减少未使用代码。
# CONFIG_DRIVER_GPIO is not set
```

## components/soc/cl1-2512/Kconfig
```kconfig
config SOC_CL1_2512
    bool
    default y

menu "Peripheral Drivers"
    config DRIVER_SYS_UART
        bool "SYS_UART Driver Support"
        default y

    config DRIVER_GPIO
        bool "GPIO Driver Support"
        default y

    config DRIVER_I2C
        bool "I2C Driver Support"
        default y

    config DRIVER_TIMER
        bool "Timer Driver Support"
        default y
endmenu
```

## templates/clint/t1/configs/defconfig
```kconfig
# 选择 StartySky T1 并启用 CLINT 和系统串口驱动。
CONFIG_STARTYSKY_T1=y
CONFIG_DRIVER_SYS_UART=y
CONFIG_DRIVER_CLINT=y
CONFIG_CPU_FREQ_MHZ=20
CONFIG_UART_BAUD_RATE=115200
CONFIG_BUILD_OPT_SIZE=y
CONFIG_BUILD_OPT_FLAGS="-Os"
CONFIG_BUILD_DEBUG=y
CONFIG_FIRMWARE_NAME="startysky_t1_clint"
CONFIG_FIRMWARE_VERSION="1.0.0"
# CONFIG_LINK_LIBC is not set
# CONFIG_LINK_LIBGCC is not set
```

## templates/gpio_interrupt/t1/configs/defconfig
```kconfig
# 选择 StartySky T1 并启用 GPIO 外部中断依赖。
CONFIG_STARTYSKY_T1=y
CONFIG_DRIVER_SYS_UART=y
CONFIG_DRIVER_GPIO=y
CONFIG_DRIVER_GPIO_INTERRUPT=y
CONFIG_CPU_FREQ_MHZ=20
CONFIG_UART_BAUD_RATE=115200
CONFIG_BUILD_OPT_SIZE=y
CONFIG_BUILD_OPT_FLAGS="-Os"
CONFIG_BUILD_DEBUG=y
CONFIG_FIRMWARE_NAME="startysky_t1_gpio_interrupt"
CONFIG_FIRMWARE_VERSION="1.0.0"
# CONFIG_LINK_LIBC is not set
# CONFIG_LINK_LIBGCC is not set
```

## templates/hello/t1-pico/configs/defconfig
```kconfig
# 选择 StartySky T1-Pico 并只启用系统串口驱动。
CONFIG_STARTYSKY_T1_PICO=y
CONFIG_DRIVER_SYS_UART=y

# 配置处理器和系统串口参数。
CONFIG_CPU_FREQ_MHZ=20
CONFIG_UART_BAUD_RATE=115200

# 配置最小固件的构建参数和名称。
CONFIG_BUILD_OPT_SIZE=y
CONFIG_BUILD_OPT_FLAGS="-Os"
CONFIG_BUILD_DEBUG=y
CONFIG_FIRMWARE_NAME="startysky_t1_pico_uart"
CONFIG_FIRMWARE_VERSION="1.0.0"

# 保持当前示例不需要的 SDK 运行库关闭。
# CONFIG_LINK_LIBC is not set
# CONFIG_LINK_LIBGCC is not set
```

## templates/i2c_scan/t1/configs/defconfig
```kconfig
# 选择 StartySky T1 并启用系统串口和 I2C0 驱动。
CONFIG_STARTYSKY_T1=y
CONFIG_DRIVER_SYS_UART=y
CONFIG_DRIVER_I2C=y

# 配置处理器和系统串口参数。
CONFIG_CPU_FREQ_MHZ=20
CONFIG_UART_BAUD_RATE=115200

# 配置 I2C 地址扫描固件的构建参数和名称。
CONFIG_BUILD_OPT_SIZE=y
CONFIG_BUILD_OPT_FLAGS="-Os"
CONFIG_BUILD_DEBUG=y
CONFIG_FIRMWARE_NAME="startysky_t1_i2c_scan"
CONFIG_FIRMWARE_VERSION="1.0.0"

# 保持当前示例不需要的 SDK 运行库关闭。
# CONFIG_LINK_LIBC is not set
# CONFIG_LINK_LIBGCC is not set
```

## templates/isram/t1-pico/configs/defconfig
```kconfig
# 选择 StartySky T1-Pico，ISRAM 测试只需要系统串口驱动。
CONFIG_STARTYSKY_T1_PICO=y
CONFIG_DRIVER_SYS_UART=y
CONFIG_CPU_FREQ_MHZ=20
CONFIG_UART_BAUD_RATE=115200
CONFIG_BUILD_OPT_SIZE=y
CONFIG_BUILD_OPT_FLAGS="-Os"
CONFIG_BUILD_DEBUG=y
CONFIG_FIRMWARE_NAME="startysky_t1_pico_isram"
CONFIG_FIRMWARE_VERSION="1.0.0"
# CONFIG_LINK_LIBC is not set
# CONFIG_LINK_LIBGCC is not set
```

## templates/isram/t1/configs/defconfig
```kconfig
# 选择 StartySky T1，ISRAM 测试只需要系统串口驱动。
CONFIG_STARTYSKY_T1=y
CONFIG_DRIVER_SYS_UART=y
CONFIG_CPU_FREQ_MHZ=20
CONFIG_UART_BAUD_RATE=115200
CONFIG_BUILD_OPT_SIZE=y
CONFIG_BUILD_OPT_FLAGS="-Os"
CONFIG_BUILD_DEBUG=y
CONFIG_FIRMWARE_NAME="startysky_t1_isram"
CONFIG_FIRMWARE_VERSION="1.0.0"
# CONFIG_LINK_LIBC is not set
# CONFIG_LINK_LIBGCC is not set
```

## templates/plic/t1-pico/configs/defconfig
```kconfig
# 选择 StartySky T1-Pico 并启用系统串口和机器中断驱动。
CONFIG_STARTYSKY_T1_PICO=y
CONFIG_DRIVER_SYS_UART=y
CONFIG_DRIVER_INTERRUPT=y
CONFIG_CPU_FREQ_MHZ=20
CONFIG_UART_BAUD_RATE=115200
CONFIG_BUILD_OPT_SIZE=y
CONFIG_BUILD_OPT_FLAGS="-Os"
CONFIG_BUILD_DEBUG=y
CONFIG_FIRMWARE_NAME="startysky_t1_pico_plic"
CONFIG_FIRMWARE_VERSION="1.0.0"
# CONFIG_LINK_LIBC is not set
# CONFIG_LINK_LIBGCC is not set
```

## tools/ecos_cli/src/ecos_cli/resources/Kconfig.build
```kconfig
menu "Build Configuration"
    menu "Core Runtime"
        config ECOS_LOG_LEVEL
            int "Minimum compiled log level"
            range 0 5
            default 1

        config ECOS_LOG_BUFFER_SIZE
            int "Log formatting buffer size"
            range 64 1024
            default 256

        config ECOS_LOG_COLOR
            bool "Enable ANSI log colors"
            default n

        config ECOS_LOG_SOURCE_LOCATION
            bool "Include source location in logs"
            default y if BUILD_DEBUG
            default n

        config ECOS_ERROR_DESCRIPTIONS
            int "Include error descriptions"
            range 0 1
            default 1
    endmenu

    menu "Application Components"
        config COMPONENT_COROUTINE
            bool "Enable LightCoroutine configuration"
            default n

        config COMPONENT_COROUTINE_USE_IDLE_TASK
            bool "Use the coroutine idle task"
            default y
            depends on COMPONENT_COROUTINE

        config COMPONENT_COROUTINE_MAX_TASK_NUM
            int "Maximum coroutine tasks"
            default 10
            depends on COMPONENT_COROUTINE

        config COMPONENT_COROUTINE_USE_CTX
            bool "Preserve coroutine local context"
            default y
            depends on COMPONENT_COROUTINE

        config COMPONENT_COROUTINE_TASK_CTX_SIZE
            int "Coroutine context words"
            default 64
            depends on COMPONENT_COROUTINE && COMPONENT_COROUTINE_USE_CTX
    endmenu

    choice
        bool "Optimization Level"
        default BUILD_OPT_NONE if STARRYSKY_L4_C1 || STARRYSKY_L4_C2 || STARRYSKY_L4_C3
        default BUILD_OPT_SIZE

        config BUILD_OPT_NONE
            bool "No optimization (-O0)"

        config BUILD_OPT_SIZE
            bool "Optimize for size (-Os)"

        config BUILD_OPT_SPEED
            bool "Optimize for speed (-O2)"

        config BUILD_OPT_MAX
            bool "Maximum optimization (-O3)"
    endchoice

    config BUILD_OPT_FLAGS
        string
        default "-O0" if BUILD_OPT_NONE
        default "-Os" if BUILD_OPT_SIZE
        default "-O2" if BUILD_OPT_SPEED
        default "-O3" if BUILD_OPT_MAX

    config BUILD_DEBUG
        bool "Enable debug information"
        default y

    config BUILD_VERBOSE
        bool "Verbose build output"
        default n
endmenu

menu "Firmware Configuration"
    config FIRMWARE_NAME
        string "Firmware name"
        default "retrosoc_fw"

    config FIRMWARE_VERSION
        string "Firmware version"
        default "1.0.0"
endmenu
```

## tools/kconfig/Kconfig
```kconfig
mainmenu "ECOS Embedded SDK Configuration"

source "$(BoardExport)"
source "$(DriverExport)"
source "$(BuildExport)"
```

## tools/kconfig/Kconfig.build
```kconfig
menu "Build Configuration"
    menu "Library Configuration"
        config LINK_LIBC
            bool "link libc"
            default y

        config LINK_LIBGCC
            bool "link libgcc"
            default y

        menu "Core Runtime"
            config ECOS_LOG_LEVEL
                int "Minimum compiled log level"
                range 0 5
                default 1
                help
                    0=Debug, 1=Info, 2=Warn, 3=Error, 4=Fatal, 5=Off.

            config ECOS_LOG_BUFFER_SIZE
                int "Log formatting buffer size"
                range 64 1024
                default 256

            config ECOS_LOG_COLOR
                bool "Enable ANSI log colors"
                default n

            config ECOS_LOG_SOURCE_LOCATION
                bool "Include source location in logs"
                default y if BUILD_DEBUG
                default n

            config ECOS_ERROR_DESCRIPTIONS
                int "Include error descriptions"
                range 0 1
                default 1
        endmenu

        config COMPONENT_SPI_SOFTWARE
            bool "Spi Software Support"
            default n

        config COMPONENT_SFUD
            bool "Serial Flash Universal Driver Support"
            depends on DRIVER_QSPI
            default n

        config COMPONENT_FLASH_FS
            bool "FileSystem Support"
            depends on COMPONENT_SFUD
            default n

        menu "Shell Support"
            config COMPONENT_SHELL
                bool "Shell Support"
                default n

            config COMPONENT_FILE_EDITOR
                bool "File Editor Support"
                depends on COMPONENT_SHELL && COMPONENT_FLASH_FS
                default n

            config COMPONENT_C_COMPILER
                bool "C Compiler Support"
                depends on COMPONENT_SHELL && COMPONENT_FLASH_FS
                default n
        endmenu

        menu "LightCoroutine Support"
            config COMPONENT_COROUTINE
                bool "LightCoroutine Support"
                default n

            config COMPONENT_COROUTINE_USE_IDLE_TASK
                bool "USE_IDLE_TASK"
                default y
                depends on COMPONENT_COROUTINE

            config COMPONENT_COROUTINE_MAX_TASK_NUM
                int "MAX_TASK_NUM"
                default 10
                depends on COMPONENT_COROUTINE

            config COMPONENT_COROUTINE_USE_CTX
                bool "USE_CTX"
                default y
                depends on COMPONENT_COROUTINE

            config COMPONENT_COROUTINE_TASK_CTX_SIZE
                int "TASK_CTX_SIZE"
                default 64
                depends on COMPONENT_COROUTINE && COMPONENT_COROUTINE_USE_CTX
        endmenu
    endmenu

    choice
        bool "Optimization Level"
        default BUILD_OPT_NONE if STARRYSKY_L4
        default BUILD_OPT_SIZE

        config BUILD_OPT_NONE
            bool "No optimization (-O0)"

        config BUILD_OPT_SIZE
            bool "Optimize for size (-Os)"

        config BUILD_OPT_SPEED
            bool "Optimize for speed (-O2)"

        config BUILD_OPT_MAX
            bool "Maximum optimization (-O3)"
    endchoice

    config BUILD_OPT_FLAGS
        string
        default "-O0" if BUILD_OPT_NONE
        default "-Os" if BUILD_OPT_SIZE
        default "-O2" if BUILD_OPT_SPEED
        default "-O3" if BUILD_OPT_MAX

    config BUILD_DEBUG
        bool "Enable debug information"
        default y

    config BUILD_VERBOSE
        bool "Verbose build output"
        default n
endmenu

menu "Firmware Configuration"
    config FIRMWARE_NAME
        string "Firmware name"
        default "retrosoc_fw"

    config FIRMWARE_VERSION
        string "Firmware version"
        default "1.0.0"
endmenu
```
